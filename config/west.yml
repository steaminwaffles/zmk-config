## config/west.yml
```yaml
manifest:
  remotes:
    - name: zmkfirmware
      url-base: https://github.com/zmkfirmware
    - name: petejohanson
      url-base: https://github.com/petejohanson
    - name: Deemen17
      url-base: https://github.com/Deemen17

  projects:
    - name: zmk
      remote: Deemen17
      revision: display/bongo-cat-widget
      import: app/west.yml
      
  self:
    path: config
```
